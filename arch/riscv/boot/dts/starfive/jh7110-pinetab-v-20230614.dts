// SPDX-License-Identifier: GPL-2.0 OR MIT
/*
 * Copyright (C) 2022 StarFive Technology Co., Ltd.
 * Copyright (C) 2022 Hal Feng <hal.feng@starfivetech.com>
 */

/dts-v1/;

#include "jh7110-pinetab-v.dtsi"

&gpio_keys {
	vol-up-key {
		label = "vol up key";
		debounce-interval = <10>;
		linux,input-type = <EV_KEY>;
		linux,code = <KEY_VOLUMEUP>;
		gpios = <&sysgpio 51 GPIO_ACTIVE_LOW>;
	};
};

&charger {
	ti,input-current-limit = <2000000>; /* maximum input current limit (in uA) as 20230614 boards can't detect what type of Charger is connected */
};
