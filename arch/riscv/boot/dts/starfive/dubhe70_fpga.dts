// SPDX-License-Identifier: (GPL-2.0 OR MIT)
/* Copyright (c) 2023 StarFive Technology Co., Ltd. */

#include "dubhe70.dtsi"
#include "dubhe_fpga_common.dtsi"

/ {
	soc {
		/delete-property/ dma-noncoherent;
		dma-coherent;
	};
};

&l3_pmu {
	compatible = "starfive,dubhe70-starlink-pmu", "starfive,jh8100-starlink-pmu";
	status = "okay";
};
