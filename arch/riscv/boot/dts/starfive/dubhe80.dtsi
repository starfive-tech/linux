// SPDX-License-Identifier: (GPL-2.0 OR MIT)
/* Copyright (c) 2023-2024 StarFive Technology Co., Ltd. */

#include "dubhe.dtsi"
#include "dubhe80-cpus.dtsi"

/ {
	compatible = "starfive,dubhe-80";
};
