// SPDX-License-Identifier: GPL-2.0 OR MIT
/*
 * Copyright (C) 2022 StarFive Technology Co., Ltd.
 * Copyright (C) 2022 Hal Feng <hal.feng@starfivetech.com>
 */

/dts-v1/;
#include "jh7110-visionfive-v2.dts"
#include "codecs/sf_tdm.dtsi"

&i2c0 {
	wm8960: codec@1a {
		compatible = "wlf,wm8960";
		reg = <0x1a>;
		wlf,shared-lrclk;
		#sound-dai-cells = <0>;
	};
};

&tdm {
	status = "disabled";
};
