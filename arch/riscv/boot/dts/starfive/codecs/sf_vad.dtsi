&sound {
	/* pdm + i2svad */
	simple-audio-card,dai-link@1 {
		reg = <1>;
		format = "i2s";
		bitclock-master = <&sndcodec1>;
		frame-master = <&sndcodec1>;

		cpu {
			sound-dai = <&i2svad>;
		};

		sndcodec1: codec {
			sound-dai = <&pdm>;
		};
	};
	
};
