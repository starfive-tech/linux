// SPDX-License-Identifier: (GPL-2.0 OR MIT)
/* Copyright (c) 2021-2024 StarFive Technology Co., Ltd. */

#include "dubhe.dtsi"
#include "dubhe90-cpus.dtsi"

/ {
	compatible = "starfive,dubhe-90";
};
