## drivers/gpu/drm/img/img-drm-nulldisp/Kconfig
```kconfig
config DRM_IMG_NULLDISP
        bool "IMG DRM support null disp"
        select DRM_IMG
	select DRM_LEGACY
        default n
        help
          Enable IMG null disp for powerVR GPU
```

## drivers/gpu/drm/img/img-rogue/Kconfig
```kconfig
config DRM_IMG_ROGUE
	tristate "DRM support for PowerVR GPU"
	select DRM_IMG
	default n
	help
	  Enable img powerVR GPU
```

## drivers/gpu/drm/starfive/Kconfig
```kconfig
# SPDX-License-Identifier: GPL-2.0
# Copyright (C) 2021 StarFive Technology Co., Ltd.

config DRM_STARFIVE
	tristate "DRM Support for StarFive SoCs"
	depends on DRM
	depends on SIFIVE_L2
	depends on SOC_STARFIVE || COMPILE_TEST
	select DRM_GEM_CMA_HELPER
	select DRM_KMS_HELPER
	select DRM_MIPI_DSI
	select DRM_PANEL
	help
	  Choose this option if you have a StarFive SoCs.
	  The module will be called starfive-drm
	  This driver provides kernel mode setting and
	  buffer management to userspace.
```

## drivers/gpu/drm/verisilicon/Kconfig
```kconfig
# SPDX-License-Identifier: GPL-2.0
config DRM_VERISILICON
	tristate "DRM Support for VeriSilicon"
	depends on DRM
	select DRM_KMS_HELPER
	select DRM_GEM_DMA_HELPER
	select CMA
	select DMA_CMA
	help
	  Choose this option if you have a VeriSilicon soc chipset.
	  This driver provides VeriSilicon kernel mode
	  setting and buffer management. It does not
	  provide 2D or 3D acceleration.

config DRM_VERISILICON_STARFIVE_HDMI
	bool "Starfive HDMI extensions"
	depends on DRM_VERISILICON
	help
	   This selects support for StarFive soc specific extensions
	   for the Innosilicon HDMI driver. If you want to enable
	   HDMI on JH7110 based soc, you should select this option.
```

## drivers/media/platform/starfive/Kconfig
```kconfig
# SPDX-License-Identifier: GPL-2.0-only

comment "Starfive media platform drivers"

config VIN_SENSOR_OV5640
	tristate "VIN SENSOR support OV5640"
	depends on VIDEO_STF_VIN
	select V4L2_FWNODE
	default n
	help
	  Say Y here if you want to have support for VIN sensor OV5640

config VIN_SENSOR_SC2235
	tristate "VIN SENSOR support SC2235"
	depends on VIDEO_STF_VIN
	select V4L2_FWNODE
	default n
	help
	  Say Y here if you want to have support for VIN sensor SC2235

config VIN_SENSOR_OV4689
	tristate "VIN SENSOR support OV4689"
	depends on VIDEO_STF_VIN
	select V4L2_FWNODE
	default n

	help
	  Say Y here if you want to have support for VIN sensor OV4689

config VIN_SENSOR_OV13850
	bool "VIN SENSOR support OV13850"
	depends on VIDEO_STF_VIN
	select V4L2_FWNODE
	default n
	help
	  Say Y here if you want to have support for VIN sensor OV13850

config VIN_SENSOR_IMX219
	tristate "VIN SENSOR support IMX219"
	depends on VIDEO_STF_VIN
	select V4L2_FWNODE
	default n
	help
	  Say Y here if you want to have support for VIN sensor IMX219

config VIDEO_STF_VIN
	tristate "starfive VIC video in support"
	depends on V4L_PLATFORM_DRIVERS
	depends on VIDEO_DEV
	select MEDIA_CONTROLLER
	select VIDEOBUF2_DMA_CONTIG
	select VIDEO_V4L2_SUBDEV_API
	select V4L2_FWNODE
	help
	  To compile this driver as a module, choose M here: the module
	  will be called stf-vin.
```

## drivers/net/wireless/eswin/Kconfig
```kconfig
# SPDX-License-Identifier: GPL-2.0-only
config USB_WIFI_ECR6600U
	tristate "USB WIFI ECR6600U"
	help
	  usb wifi ECR6600U.
```

## drivers/nvdla/Kconfig
```kconfig
config NVDLA
	tristate "The NVIDIA Deep Learning Accelerator"
	depends on DRM
	select DRM_GEM_CMA_HELPER
```

## drivers/phy/starfive/Kconfig
```kconfig
# SPDX-License-Identifier: GPL-2.0-only
#
# Phy drivers for StarFive platforms
#

config PHY_STARFIVE_DPHY_RX
	tristate "StarFive D-PHY RX Support"
	select GENERIC_PHY
	select GENERIC_PHY_MIPI_DPHY
	help
	  Choose this option if you have a StarFive D-PHY in your
	  system. If M is selected, the module will be called
	  phy-starfive-dphy-rx.

config PHY_STARFIVE_JH7110_USB
	tristate "Starfive JH7110 USB 2.0 PHY support"
	depends on USB_SUPPORT
	select GENERIC_PHY
	select USB_PHY
	help
	  Enable this to support the StarFive USB 2.0 PHY,
	  used with the Cadence USB controller.
	  If M is selected, the module will be called
	  phy-jh7110-usb.ko.
```

## drivers/pinctrl/starfive/Kconfig
```kconfig
# SPDX-License-Identifier: GPL-2.0-only

config PINCTRL_STARFIVE
	bool "Pinctrl driver for StarFive SoC"
	depends on OF
	depends on RISCV || COMPILE_TEST
	select GENERIC_PINCTRL_GROUPS
	select GENERIC_PINMUX_FUNCTIONS
	select GENERIC_PINCONF
	select GPIOLIB
	select GPIOLIB_IRQCHIP
	select OF_GPIO
	help
	  Say yes here to support pin control on the StarFive RISC-V SoC.
	  This also provides an interface to the GPIO pins not used by other
	  peripherals supporting inputs, outputs, configuring pull-up/pull-down
	  and interrupts on input changes.

config PINCTRL_STARFIVE_JH7100
	tristate "Pinctrl and GPIO driver for the StarFive JH7100 SoC"
	depends on SOC_STARFIVE || COMPILE_TEST
	depends on OF
	select GENERIC_PINCTRL_GROUPS
	select GENERIC_PINMUX_FUNCTIONS
	select GENERIC_PINCONF
	select GPIOLIB
	select GPIOLIB_IRQCHIP
	select OF_GPIO
	default SOC_STARFIVE
	help
	  Say yes here to support pin control on the StarFive JH7100 SoC.
	  This also provides an interface to the GPIO pins not used by other
	  peripherals supporting inputs, outputs, configuring pull-up/pull-down
	  and interrupts on input changes.

config PINCTRL_STARFIVE_JH7110
	bool "Pinctrl and GPIO driver for StarFive JH7110 SoC"
	depends on  PINCTRL_STARFIVE
	depends on SOC_STARFIVE_JH7110
	help
	  This selects the pinctrl driver for JH7110 starfive.
```

## drivers/reset/starfive/Kconfig
```kconfig
# SPDX-License-Identifier: GPL-2.0-only

config RESET_STARFIVE_JH7100
	bool "StarFive JH7100 Reset Driver"
	depends on SOC_STARFIVE || COMPILE_TEST
	default SOC_STARFIVE
	help
	  This enables the reset controller driver for the StarFive JH7100 SoC.
```

## drivers/soc/sifive/Kconfig
```kconfig
# SPDX-License-Identifier: GPL-2.0

if SOC_SIFIVE

config SIFIVE_L2
	bool "Sifive L2 Cache controller"
	help
	  Support for the L2 cache controller on SiFive platforms.

config SIFIVE_L2_FLUSH
	bool "Support Level 2 Cache Controller Flush operation of SiFive Soc"

if SIFIVE_L2_FLUSH

config SIFIVE_L2_FLUSH_START
	hex "Level 2 Cache Flush operation start"
	default 0x80000000

config SIFIVE_L2_FLUSH_SIZE
	hex "Level 2 Cache Flush operation size"
	default 0x800000000

endif # SIFIVE_L2_FLUSH

config SIFIVE_L2_IRQ_DISABLE
	bool "Disable Level 2 Cache Controller interrupts"
	default y if SOC_STARFIVE_VIC7100

endif
```

## drivers/soc/starfive/Kconfig
```kconfig
# SPDX-License-Identifier: GPL-2.0

config JH71XX_PMU
	bool "Support PMU for StarFive JH71XX Soc"
	depends on PM
	depends on SOC_STARFIVE || COMPILE_TEST
	default SOC_STARFIVE
	select PM_GENERIC_DOMAINS
	help
	  Say 'y' here to enable support power domain support.
	  In order to meet low power requirements, a Power Management Unit (PMU)
	  is designed for controlling power resources in StarFive JH71XX SoCs.

config ARCH_DUBHE_FPGA
	bool "Dubhe FPGA platform support"
	depends on ARCH_STARFIVE
	depends on RISCV_ALTERNATIVE
	depends on RISCV_SBI
	select STARFIVE_DUBHE_L2_CACHE
	select DMA_GLOBAL_POOL
	select ERRATA_STARFIVE
	select ERRATA_STARFIVE_CMO
	help
	  This enables support for the StarFive Dubhe FPGA SoC.
```

## drivers/video/fbdev/starfive/Kconfig
```kconfig
#
# Video TX driver configuration
#
menu "Displayer Configuration for VIC board"

choice
	prompt "Displayer support for VIC board"
	default FB_STARFIVE_HDMI_TDA998X
	depends on FB_STARFIVE
	optional

config FB_STARFIVE_HDMI_ADV7513
	bool "HDMI ADV7513 displayer support"
	help
	  Say Y here if you want to have support for ADV7513 displayer

config FB_STARFIVE_HDMI_TDA998X
	bool "HDMI TDA998X displayer support"
	help
	  Say Y here if you want to have support for TDA998X displayer

config FB_STARFIVE_SEEED5INCH
	bool "seeed5inch mipi LCD panel displayer support"
	help
	  Say Y here if you want to have support for seeed5inch mipi LCD panel

endchoice

config FB_STARFIVE_VIDEO
	bool "Cam sensor image data to framebuffer, instead of Console"
	depends on FB_STARFIVE && VIDEO_STARFIVE_VIN
	help
	  Say Y here if you want to display video from sensor, instead of console.

endmenu
```

## net/ethercat/Kconfig
```kconfig
# SPDX-License-Identifier: GPL-2.0-only
#
# ethercat
#

config ETHERCAT
	tristate "ETHERCAT master driver"
	select ETHERCAT_MASTER
	default n
	help
	  Support for ethercat master driver.
	  If unsure, say Y.

source "net/ethercat/master/Kconfig"
```

## net/ethercat/master/Kconfig
```kconfig
# SPDX-License-Identifier: GPL-2.0-only
#
# ethercat
#

config ETHERCAT_MASTER
	tristate "ethercat master"
	default n
	help
	  Support for ethercat master driver.
	  If unsure, say Y.

config ETHERCAT_RTDM
	bool "ethercat rtdm"
	depends on ETHERCAT_MASTER
	default n
	help
	  Support for ethercat master driver.
	  If unsure, say Y.
```
