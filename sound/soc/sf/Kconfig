## sound/soc/sf/Kconfig
```kconfig
config SND_SF_SOUND_CARD
	tristate "starfive sound card"
	select REGMAP_MMIO
	help
	  Say Y or M if you want to add support for codecs attached to the
	  I2S interface on VIC vic_starlight board. You will also need to select
	  the drivers for the rest of VIC audio subsystem.
	  
config SND_SF_MULTI_DAI
	tristate "starfive multi dai"
	select REGMAP_MMIO
	help
	  Say Y or M if you want to add support for codecs attached to the
	  I2S interface on VIC vic_starlight board. You will also need to select
	  the drivers for the rest of VIC audio subsystem.
	  
config SND_SF_SPDIF
	tristate "starfive spdif"
	select REGMAP_MMIO
	help
	  Say Y or M if you want to add support for codecs attached to the
	  I2S interface on VIC vic_starlight board. You will also need to select
	  the drivers for the rest of VIC audio subsystem.
	  
config SND_SF_SPDIF_PCM
	bool "PCM PIO extension for spdif driver"
	depends on SND_SF_SPDIF
	help
	 Say Y or N if you want to add a custom ALSA extension that registers
	 a PCM and uses PIO to transfer data.
	 
config SND_SF_PWMDAC
	tristate "starfive pwmdac Device Driver"
	select SND_SOC_GENERIC_DMAENGINE_PCM
	help
	 Say Y or M if you want to add support for sf pwmdac driver.

config SND_SF_PWMDAC_PCM
	bool "PCM PIO extension for pwmdac driver"
	depends on SND_SF_PWMDAC
	help
	 Say Y or N if you want to add a custom ALSA extension that registers
	 a PCM and uses PIO to transfer data.
	 
config SND_SF_PDM
	tristate "starfive pdm Device Driver"
	select REGMAP_MMIO
	help
	 Say Y or M if you want to add support for sf pdm driver.
```

## sound/soc/starfive/Kconfig
```kconfig
# SPDX-License-Identifier: GPL-2.0-only
config SND_SOC_STARFIVE
	tristate "Audio support for StarFive SoC"
	depends on COMPILE_TEST || ARCH_STARFIVE
	help
	  Say Y or M if you want to add support for codecs attached to
	  the Starfive SoCs' Audio interfaces. You will also need to
	  select the audio interfaces to support below.

config SND_SOC_JH7110_PWMDAC
	tristate "JH7110 PWM-DAC device driver"
	depends on HAVE_CLK && SND_SOC_STARFIVE
	select SND_SOC_GENERIC_DMAENGINE_PCM
	select SND_SOC_SPDIF
	help
	 Say Y or M if you want to add support for StarFive JH7110
	 PWM-DAC driver.

config SND_SOC_JH7110_TDM
	tristate "JH7110 TDM device driver"
	depends on HAVE_CLK && SND_SOC_STARFIVE
	select SND_SOC_GENERIC_DMAENGINE_PCM
	help
	  Say Y or M if you want to add support for StarFive TDM driver.

config SND_STARFIVE_SPDIF
	tristate "starfive spdif"
	depends on SOC_STARFIVE || COMPILE_TEST
	select SND_SOC_GENERIC_DMAENGINE_PCM
	select REGMAP_MMIO
	help
	  Say Y or M if you want to add support for codecs attached to the
	  I2S interface on VIC vic_starlight board. You will also need to select
	  the drivers for the rest of VIC audio subsystem.

config SND_STARFIVE_SPDIF_PCM
	bool "PCM PIO extension for spdif driver"
	depends on SND_STARFIVE_SPDIF
	help
	 Say Y or N if you want to add a custom ALSA extension that registers
	 a PCM and uses PIO to transfer data.

config SND_STARFIVE_PWMDAC
	tristate "starfive pwmdac Device Driver"
	depends on SOC_STARFIVE || COMPILE_TEST
	select SND_SOC_GENERIC_DMAENGINE_PCM
	help
	 Say Y or M if you want to add support for sf pwmdac driver.

config SND_STARFIVE_PWMDAC_PCM
	bool "PCM PIO extension for pwmdac driver"
	depends on SND_STARFIVE_PWMDAC
	help
	 Say Y or N if you want to add a custom ALSA extension that registers
	 a PCM and uses PIO to transfer data.

config SND_STARFIVE_PDM
	tristate "starfive pdm Device Driver"
	depends on SOC_STARFIVE || COMPILE_TEST
	select REGMAP_MMIO
	help
	 Say Y or M if you want to add support for sf pdm driver.

config SND_STARFIVE_I2SVAD
	tristate "starfive I2SVAD Device Driver"
	depends on SOC_STARFIVE || COMPILE_TEST
	select SND_SOC_GENERIC_DMAENGINE_PCM
	help
	 Say Y or M if you want to add support for I2SVAD driver for
	 starfive I2SVAD device.

config SND_STARFIVE_I2SVAD_PCM
	bool "PCM PIO extension for I2SVAD driver"
	depends on SND_STARFIVE_I2SVAD
	help
	 Say Y or N if you want to add a custom ALSA extension that registers
	 a PCM and uses PIO to transfer data.

	 This functionality is specially suited for I2SVAD devices that don't have
	 DMA support.
```

## sound/soc/startfive/Kconfig
```kconfig
config SND_STARTFIVE_SPDIF
	tristate "starfive spdif"
	select REGMAP_MMIO
	help
	  Say Y or M if you want to add support for codecs attached to the
	  I2S interface on VIC vic_starlight board. You will also need to select
	  the drivers for the rest of VIC audio subsystem.
	  
config SND_STARTFIVE_SPDIF_PCM
	bool "PCM PIO extension for spdif driver"
	depends on SND_STARTFIVE_SPDIF
	help
	 Say Y or N if you want to add a custom ALSA extension that registers
	 a PCM and uses PIO to transfer data.
	 
config SND_STARTFIVE_PWMDAC
	tristate "starfive pwmdac Device Driver"
	select SND_SOC_GENERIC_DMAENGINE_PCM
	help
	 Say Y or M if you want to add support for sf pwmdac driver.

config SND_STARTFIVE_PWMDAC_PCM
	bool "PCM PIO extension for pwmdac driver"
	depends on SND_STARTFIVE_PWMDAC
	help
	 Say Y or N if you want to add a custom ALSA extension that registers
	 a PCM and uses PIO to transfer data.
	 
config SND_STARTFIVE_PDM
	tristate "starfive pdm Device Driver"
	select REGMAP_MMIO
	help
	 Say Y or M if you want to add support for sf pdm driver.
	 
config SND_STARTFIVE_I2SVAD
	tristate "starfive I2SVAD Device Driver"
	select SND_SOC_GENERIC_DMAENGINE_PCM
	help
	 Say Y or M if you want to add support for I2SVAD driver for
	 starfive I2SVAD device.

config SND_STARTFIVE_I2SVAD_PCM
	bool "PCM PIO extension for I2SVAD driver"
	depends on SND_STARTFIVE_I2SVAD
	help
	 Say Y or N if you want to add a custom ALSA extension that registers
	 a PCM and uses PIO to transfer data.

	 This functionality is specially suited for I2SVAD devices that don't have
	 DMA support.
```
