## Documentation/devicetree/bindings/pwm/starfive,jh7110-pwm.yaml
```yaml
# SPDX-License-Identifier: GPL-2.0-only OR BSD-2-Clause
%YAML 1.2
---
$id: http://devicetree.org/schemas/pwm/starfive,jh7110-pwm.yaml#
$schema: http://devicetree.org/meta-schemas/core.yaml#

title: StarFive PWM controller

maintainers:
  - William Qiu <william.qiu@starfivetech.com>

description:
  StarFive SoCs contain PWM and when operating in PWM mode, the PTC core generates
  binary signal with user-programmable low and high periods. Clock source for the
  PWM can be either system clockor external clock. Each PWM timer block provides 8
  PWM channels.

allOf:
  - $ref: pwm.yaml#

properties:
  compatible:
    const: starfive,jh7110-pwm

  reg:
    maxItems: 1

  clocks:
    maxItems: 1

  resets:
    maxItems: 1

  "#pwm-cells":
    const: 3

required:
  - compatible
  - reg
  - clocks
  - resets

additionalProperties: false

examples:
  - |
    pwm@120d0000 {
        compatible = "starfive,jh7110-pwm";
        reg = <0x120d0000 0x10000>;
        clocks = <&syscrg 121>;
        resets = <&syscrg 108>;
        #pwm-cells = <3>;
    };
```

## Documentation/devicetree/bindings/reset/starfive,jh7100-audrst.yaml
```yaml
# SPDX-License-Identifier: GPL-2.0-only OR BSD-2-Clause
%YAML 1.2
---
$id: http://devicetree.org/schemas/reset/starfive,jh7100-audrst.yaml#
$schema: http://devicetree.org/meta-schemas/core.yaml#

title: StarFive JH7100 SoC Audio Reset Controller Device Tree Bindings

maintainers:
  - Emil Renner Berthing <kernel@esmil.dk>

properties:
  compatible:
    enum:
      - starfive,jh7100-audrst

  reg:
    maxItems: 1

  "#reset-cells":
    const: 1

required:
  - compatible
  - reg
  - "#reset-cells"

additionalProperties: false

examples:
  - |
    reset-controller@10490000 {
        compatible = "starfive,jh7100-audrst";
        reg = <0x10490000 0x10000>;
        #reset-cells = <1>;
    };

...
```

## Documentation/devicetree/bindings/timer/starfive,jh7110-timer.yaml
```yaml
# SPDX-License-Identifier: (GPL-2.0-only OR BSD-2-Clause)
%YAML 1.2
---
$id: http://devicetree.org/schemas/timer/starfive,jh7110-timer.yaml#
$schema: http://devicetree.org/meta-schemas/core.yaml#

title: StarFive JH7110 Timer

maintainers:
  - Xingyu Wu <xingyu.wu@starfivetech.com>
  - Samin Guo <samin.guo@starfivetech.com>

description:
  This timer has four free-running 32 bit counters in StarFive JH7110 SoC.
  And each channel(counter) triggers an interrupt when timeout. They support
  one-shot mode and continuous-run mode.

properties:
  compatible:
    const: starfive,jh7110-timer

  reg:
    maxItems: 1

  interrupts:
    items:
      - description: channel 0
      - description: channel 1
      - description: channel 2
      - description: channel 3

  clocks:
    items:
      - description: timer APB
      - description: channel 0
      - description: channel 1
      - description: channel 2
      - description: channel 3

  clock-names:
    items:
      - const: apb
      - const: ch0
      - const: ch1
      - const: ch2
      - const: ch3

  resets:
    items:
      - description: timer APB
      - description: channel 0
      - description: channel 1
      - description: channel 2
      - description: channel 3

  reset-names:
    items:
      - const: apb
      - const: ch0
      - const: ch1
      - const: ch2
      - const: ch3

required:
  - compatible
  - reg
  - interrupts
  - clocks
  - clock-names
  - resets
  - reset-names

additionalProperties: false

examples:
  - |
    timer@13050000 {
        compatible = "starfive,jh7110-timer";
        reg = <0x13050000 0x10000>;
        interrupts = <69>, <70>, <71> ,<72>;
        clocks = <&clk 124>,
                 <&clk 125>,
                 <&clk 126>,
                 <&clk 127>,
                 <&clk 128>;
        clock-names = "apb", "ch0", "ch1",
                      "ch2", "ch3";
        resets = <&rst 117>,
                 <&rst 118>,
                 <&rst 119>,
                 <&rst 120>,
                 <&rst 121>;
        reset-names = "apb", "ch0", "ch1",
                      "ch2", "ch3";
    };
```

## Documentation/devicetree/bindings/timer/starfive,jh7110-timers.yaml
```yaml
# SPDX-License-Identifier: (GPL-2.0-only OR BSD-2-Clause)
%YAML 1.2
---
$id: http://devicetree.org/schemas/timer/starfive,jh7110-timers.yaml#
$schema: http://devicetree.org/meta-schemas/core.yaml#

title: StarFive timers bindings

maintainers:
  - samin.guo <samin.guo@starfivetech.com>
  - xingyu.wu <xingyu.wu@starfivetech.com>

properties:
  compatible:
    const: starfive,jh7110-timers

  reg:
    maxItems: 1

  interrupts:
    items:
      - description: timer channel 0 interrupt
      - description: timer channel 1 interrupt
      - description: timer channel 2 interrupt
      - description: timer channel 3 interrupt
      
  interrupt-names:
    items:
      - const: timer0
      - const: timer1
      - const: timer2
      - const: timer3

  clocks:
    items:
      - description: timer channel 0 clock
      - description: timer channel 1 clock
      - description: timer channel 2 clock
      - description: timer channel 3 clock
      - description: APB clock

  clock-names:
    items:
      - const: timer0
      - const: timer1
      - const: timer2
      - const: timer3
      - const: apb_clk

  resets:
    items:
      - description: timer channel 0 reset
      - description: timer channel 1 reset
      - description: timer channel 2 reset
      - description: timer channel 3 reset
      - description: APB reset

  reset-names:
    items:
      - const: timer0
      - const: timer1
      - const: timer2
      - const: timer3
      - const: apb_rst

required:
  - compatible
  - reg
  - interrupts
  - interrupt-names
  - clocks
  - clock-names
  - resets
  - reset-names

additionalProperties: false

examples:
  - |
    timer0: timer@15200000 {
            compatible = "starfive,jh7110-timers";
            reg = <0x15200000 0x10000>;
            interrupts = <85>, <86>, <87> ,<88>;
            interrupt-names = "timer0", "timer1", "timer2", "timer3";
            clocks = <&clkgen 125>,
                     <&clkgen 126>,
                     <&clkgen 127>,
                     <&clkgen 128>,
                     <&clkgen 129>;
            clock-names = "timer0", "timer1",
                          "timer2", "timer3", "apb_clk";
            resets = <&rstgen 118>,
                     <&rstgen 119>,
                     <&rstgen 120>,
                     <&rstgen 121>,
                     <&rstgen 122>;
            reset-names = "timer0", "timer1",
                          "timer2", "timer3", "apb_rst";
    };
```

## Documentation/devicetree/bindings/usb/starfive,jh7110-usb.yaml
```yaml
# SPDX-License-Identifier: (GPL-2.0-only OR BSD-2-Clause)
%YAML 1.2
---
$id: http://devicetree.org/schemas/usb/starfive,jh7110-usb.yaml#
$schema: http://devicetree.org/meta-schemas/core.yaml#

title: StarFive JH7110 wrapper module for the Cadence USBSS-DRD controller

maintainers:
  - Minda Chen <minda.chen@starfivetech.com>

properties:
  compatible:
    const: starfive,jh7110-usb

  clocks:
    items:
      - description: lpm clock
      - description: stb clock
      - description: apb clock
      - description: axi clock
      - description: utmi apb clock

  clock-names:
    items:
      - const: lpm
      - const: stb
      - const: apb
      - const: axi
      - const: utmi_apb

  resets:
    items:
      - description: PWRUP reset
      - description: APB reset
      - description: AXI reset
      - description: UTMI_APB reset

  starfive,sys-syscon:
    $ref: /schemas/types.yaml#/definitions/phandle-array
    items:
      items:
        - description: phandle to System Register Controller sys_syscon node.
        - description: offset of SYS_SYSCONSAIF__SYSCFG register for USB.
    description:
      The phandle to System Register Controller syscon node and the offset
      of SYS_SYSCONSAIF__SYSCFG register for USB.

  starfive,stg-syscon:
    $ref: /schemas/types.yaml#/definitions/phandle-array
    items:
      items:
        - description: phandle to System Register Controller stg_syscon node.
        - description: register0 offset of STG_SYSCONSAIF__SYSCFG register for USB.
        - description: register1 offset of STG_SYSCONSAIF__SYSCFG register for USB.
        - description: register2 offset of STG_SYSCONSAIF__SYSCFG register for USB.
        - description: register3 offset of STG_SYSCONSAIF__SYSCFG register for USB.
    description:
      The phandle to System Register Controller syscon node and the offset
      of STG_SYSCONSAIF__SYSCFG register for USB. Total 4 regsisters offset
      for USB.

  "#address-cells":
    maximum: 2

  "#size-cells":
    maximum: 2

  ranges: true

patternProperties:
  "^usb@[0-9a-f]+$":
    type: object

required:
  - compatible
  - clocks
  - clock-names
  - resets
  - starfive,sys-syscon
  - starfive,stg-syscon
  - "#address-cells"
  - "#size-cells"
  - ranges

additionalProperties: false

examples:
  - |
    usb@10100000 {
      compatible = "starfive,jh7110-usb";
      clocks = <&syscrg 4>,
               <&stgcrg 5>,
               <&stgcrg 1>,
               <&stgcrg 3>,
               <&stgcrg 2>;
      clock-names = "lpm", "stb", "apb", "axi", "utmi_apb";
      resets = <&stgcrg 10>,
               <&stgcrg 8>,
               <&stgcrg 7>,
               <&stgcrg 9>;
      starfive,stg-syscon = <&stg_syscon 0x4 0xc4 0x148 0x1f4>;
      starfive,sys-syscon = <&sys_syscon 0x18>;
      #address-cells = <1>;
      #size-cells = <1>;
      ranges = <0x0 0x10100000 0x100000>;

      usb@0 {
        compatible = "cdns,usb3";
        reg = <0x0 0x10000>,
              <0x10000 0x10000>,
              <0x20000 0x10000>;
        reg-names = "otg", "xhci", "dev";
        interrupts = <100>, <108>, <110>;
        interrupt-names = "host", "peripheral", "otg";
        maximum-speed = "super-speed";
        dr_mode = "host";
      };
    };
```
