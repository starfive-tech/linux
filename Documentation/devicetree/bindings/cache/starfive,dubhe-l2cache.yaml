## Documentation/devicetree/bindings/cache/starfive,dubhe-l2cache.yaml
```yaml
# SPDX-License-Identifier: (GPL-2.0 OR BSD-2-Clause)
%YAML 1.2
---
$id: http://devicetree.org/schemas/cache/starfive,dubhe-l2cache.yaml#
$schema: http://devicetree.org/meta-schemas/core.yaml#

title: StarFive Dubhe L2 Cache Controller

maintainers:
  - Ji Sheng Teoh <jisheng.teoh@starfivetech.com>

description:
  StarFive Dubhe L2 Cache Controller implementation predates the RISC-V CMO
  ISA extension. Dubhe vendor specific implementation is put in place to
  handle non-coherent DMA operation through a shared global memory pool.

properties:
  compatible:
    items:
      - enum:
          - starfive,dubhe-l2cache
      - const: cache

  cache-block-size:
    const: 64

  cache-level:
    const: 2

  cache-sets:
    const: 4096

  cache-size:
    const: 2097152

  cache-unified: true

additionalProperties: false

required:
  - compatible
  - cache-block-size
  - cache-level
  - cache-sets
  - cache-size
  - cache-unified

examples:
  - |
    cache-controller {
        compatible = "starfive,dubhe-l2cache", "cache";
        cache-block-size = <64>;
        cache-level = <2>;
        cache-sets = <4096>;
        cache-size = <2097152>;
        cache-unified;
    };
```

## Documentation/devicetree/bindings/clock/starfive,jh7100-clkgen.yaml
```yaml
# SPDX-License-Identifier: (GPL-2.0-only OR BSD-2-Clause)
%YAML 1.2
---
$id: http://devicetree.org/schemas/clock/starfive,jh7100-clkgen.yaml#
$schema: http://devicetree.org/meta-schemas/core.yaml#

title: StarFive JH7100 Clock Generator

maintainers:
  - FIXME <someone@starfivetech.com>
  - Geert Uytterhoeven <geert@linux-m68k.org>

properties:
  compatible:
    const: starfive,jh7100-clkgen

  reg:
    maxItems: 1

  clocks:
    items:
      - description: Main clock source (default 25 MHz)
      - description: Application-specific clock source (12-27 MHz)

  clock-names:
    items:
      - const: osc0
      - const: osc1

  '#clock-cells':
    const: 1
    description:
      See <dt-bindings/clock/starfive-jh7100-clkgen.h> for valid indices.

required:
  - compatible
  - reg
  - clocks
  - clock-names
  - '#clock-cells'

additionalProperties: false

examples:
  - |
    clkgen: clock-controller@11800000 {
            compatible = "starfive,jh7100-clkgen";
            reg = <0x11800000 0x10000>;
            clocks = <&osc0_clk>, <&osc1_clk>;
            clock-names = "osc0", "osc1";
            #clock-cells = <1>;
    };
```

## Documentation/devicetree/bindings/display/panel/xingbangda,xbd599.yaml
```yaml
# SPDX-License-Identifier: (GPL-2.0-only OR BSD-2-Clause)
%YAML 1.2
---
$id: http://devicetree.org/schemas/display/panel/xingbangda,xbd599.yaml#
$schema: http://devicetree.org/meta-schemas/core.yaml#

title: Xingbangda XBD599 5.99in MIPI-DSI LCD panel

maintainers:
  - Icenowy Zheng <icenowy@aosc.io>

allOf:
  - $ref: panel-common.yaml#

properties:
  compatible:
    const: xingbangda,xbd599
  reg: true
  backlight: true
  reset-gpios: true
  vcc-supply:
    description: regulator that supplies the VCC voltage
  iovcc-supply:
    description: regulator that supplies the IOVCC voltage

required:
  - compatible
  - reg
  - backlight
  - vcc-supply
  - iovcc-supply

additionalProperties: false

examples:
  - |
    dsi {
        #address-cells = <1>;
        #size-cells = <0>;

        panel@0 {
            compatible = "xingbangda,xbd599";
            reg = <0>;
            backlight = <&backlight>;
            iovcc-supply = <&reg_dldo2>;
            vcc-supply = <&reg_ldo_io0>;
        };
    };

...
```

## Documentation/devicetree/bindings/display/starfive/starfive,display-subsystem.yaml
```yaml
# SPDX-License-Identifier: (GPL-2.0-only OR BSD-2-Clause)
%YAML 1.2
---
$id: http://devicetree.org/schemas/display/starfive/starfive,display-subsystem.yaml#
$schema: http://devicetree.org/meta-schemas/core.yaml#

title: Starfive JH7110 Soc Display SubSystem

maintainers:
  - Keith Zhao <keith.zhao@starfivetech.com>
  - ShengYang Chen <shengyang.chen@starfivetech.com>

description:
  This is the bindings documentation for the JH7110 Soc Display Subsystem that
  includes front-end video data capture, display controller and display
  interface. such as HDMI and MIPI.

  JH7110 display pipeline have several components as below description,
  multi display controllers and corresponding physical interfaces.
  For different display scenarios, pipe0 and pipe1 maybe binding to different
  encoder. for example,

  pipe0 binding to HDMI for primary display,
  pipe1 binding to DSI for external display.

          +------------------------------+
          |                              |
          |                              |
  +----+  |   +-------------------+      |   +-------+   +------+   +------+
  |    +----->+  dc controller 0  +--->----->+HDMICtl| ->+ PHY  +-->+PANEL0+
  |AXI |  |   +-------------------+      |   +-------+   +------+   +------+
  |    |  |                              |
  |    |  |                              |
  |    |  |                              |
  |    |  |                              |
  |APB |  |   +-------------------+         +---------+    +------+  +-------+
  |    +----->+  dc controller 1  +--->---->+ dsiTx   +--->+DPHY  +->+ PANEL1+
  |    |  |   +-------------------+         +---------+    +------+  +-------+
  +----+  |                              |
          +------------------------------+


properties:
  compatible:
    const: starfive,display-subsystem

  clocks:
    items:
      - description: Clock for display system noc bus.
      - description: Core clock for display controller.
      - description: Clock for axi bus to access ddr.
      - description: Clock for ahb bus to R/W the phy regs.

  clock-names:
    items:
      - const: noc_bus
      - const: dc_core
      - const: axi_core
      - const: ahb

  resets:
    items:
      - description: Reset for axi bus.
      - description: Reset for ahb bus.
      - description: Core reset of display controller.

  reset-names:
    items:
      - const: axi
      - const: ahb
      - const: core

  ports:
    $ref: /schemas/types.yaml#/definitions/phandle-array
    items:
      maxItems: 1
    description:
      Should contain a list of phandles pointing to display interface port
      of dc-controller devices.

required:
  - compatible
  - clocks
  - clock-names
  - resets
  - reset-names
  - ports

additionalProperties: false

examples:
  - |
    display-subsystem {
        compatible = "starfive,display-subsystem";
        ports = <&dc_out>;

        clocks = <&syscrg 60>,
               <&voutcrg 4>,
               <&voutcrg 5>,
               <&voutcrg 6>;
        clock-names = "noc_bus", "dc_core", "axi_core", "ahb";
        resets = <&voutcrg 0>, <&voutcrg 1>, <&voutcrg 2>;
        reset-names = "axi", "ahb", "core";
    };
```

## Documentation/devicetree/bindings/display/starfive/starfive,dsi-encoder.yaml
```yaml
# SPDX-License-Identifier: (GPL-2.0-only OR BSD-2-Clause)
%YAML 1.2
---
$id: http://devicetree.org/schemas/display/starfive/starfive,dsi-encoder.yaml#
$schema: http://devicetree.org/meta-schemas/core.yaml#

title: starfive jh7110 soc Encoder

maintainers:
  - Keith Zhao <keith.zhao@starfivetech.com>

description:
  Device-Tree bindings for simple encoder.
  Simple encoder driver only has basic functionality.
  the hardware of dc8200 has 2 output interface, use
  syscon to select which one to be used.

properties:
  compatible:
    const: starfive,dsi-encoder

  starfive,syscon:
    $ref: /schemas/types.yaml#/definitions/phandle-array
    items:
      - items:
          - description: phandle to syscon that select crtc output.
          - description: Offset of crtc selection
          - description: Shift of crtc selection
    description:
      A phandle to syscon with two arguments that configure select output.
      The argument one is the offset of crtc selection, the
      argument two is the shift of crtc selection.

  ports:
    $ref: /schemas/graph.yaml#/properties/ports

    properties:
      port@0:
        $ref: /schemas/graph.yaml#/properties/port
        description:
          The first port should be the input coming from the associated dc channel.

      port@1:
        $ref: /schemas/graph.yaml#/properties/port
        description:
          The second port should be the output coming from the associated bridge.

    required:
      - port@0
      - port@1

required:
  - compatible
  - ports

additionalProperties: false

examples:
  - |
        dssctrl: dssctrl@295b0000 {
            compatible = "starfive,jh7110-vout-syscon", "syscon";
            reg = <0x295b0000 0x90>;
        };

        dsi_encoder: dsi_encoder {
            compatible = "starfive,dsi-encoder";
            starfive,syscon = <&dssctrl 0x8 0x12>;

            ports {
                #address-cells = <1>;
                #size-cells = <0>;
                /* input */
                port@0 {
                    #address-cells = <1>;
                    #size-cells = <0>;
                    reg = <0>;
                    dsi_input0:endpoint@0 {
                        reg = <0>;
                        remote-endpoint = <&dc_out_dpi1>;
                    };
                };
                /* output */
                port@1 {
                    reg = <1>;
                    #address-cells = <1>;
                    #size-cells = <0>;
                    dsi_out:endpoint {
                        remote-endpoint = <&mipi_in>;
                    };
                };
            };
        };
```

## Documentation/devicetree/bindings/display/starfive/starfive,jh7110-dc8200.yaml
```yaml
# SPDX-License-Identifier: (GPL-2.0-only OR BSD-2-Clause)
%YAML 1.2
---
$id: http://devicetree.org/schemas/display/starfive/starfive,jh7110-dc8200.yaml#
$schema: http://devicetree.org/meta-schemas/core.yaml#

title: StarFive display controller

description:
  The StarFive SoC uses the display controller based on Verisilicon IP
  to transfer the image data from a video memory buffer to an external
  LCD interface.

maintainers:
  - Keith Zhao <keith.zhao@starfivetech.com>

properties:
  compatible:
    const: starfive,jh7110-dc8200

  reg:
    minItems: 1
    items:
      - description:
          host interface
      - description:
          display physical base address and length.

  interrupts:
    items:
      - description: The interrupt will be generated when DC finish one frame

  clocks:
    items:
      - description: Pixel clock for display channel 0.
      - description: Pixel clock for display channel 1.
      - description: Pixel clock from hdmi.
      - description: Pixel clock for soc .
  clock-names:
    items:
      - const: channel0
      - const: channel1
      - const: hdmi_tx
      - const: dc_parent
  ports:
    $ref: /schemas/graph.yaml#/properties/ports

    properties:
      port@0:
        $ref: /schemas/graph.yaml#/properties/port
        description:
          channel 0 output

      port@1:
        $ref: /schemas/graph.yaml#/properties/port
        description:
          channel 1 output

    required:
      - port@0
      - port@1

required:
  - compatible
  - reg
  - interrupts
  - clocks
  - clock-names
  - ports

additionalProperties: false

examples:
  - |
    dc8200: lcd-controller@29400000 {
        compatible = "starfive,jh7110-dc8200";
        reg = <0x29400000 0x100>, <0x29400800 0x2000>;
        interrupts = <95>;
        clocks = <&voutcrg 7>,
               <&voutcrg 8>,
               <&voutcrg 9>,
               <&voutcrg 10>;
        clock-names = "channel0", "channel1","hdmi_tx", "dc_parent";

        crtc_out: ports {
            #address-cells = <1>;
            #size-cells = <0>;

            dc_out0: port@0 {
                reg = <0>;
                #address-cells = <1>;
                #size-cells = <0>;

                dc_out_dpi0: endpoint@0 {
                    reg = <0>;
                    remote-endpoint = <&hdmi_in_dc>;
                };

            };

            dc_out1: port@1 {
                reg = <1>;
                #address-cells = <1>;
                #size-cells = <0>;

                dc_out_dpi1: endpoint@1 {
                    reg = <1>;
                    remote-endpoint = <&dsi_input0>;
                };

            };
          };
    };
```

## Documentation/devicetree/bindings/display/starfive/starfive,jh7110-inno-hdmi.yaml
```yaml
# SPDX-License-Identifier: (GPL-2.0-only OR BSD-2-Clause)
%YAML 1.2
---
$id: http://devicetree.org/schemas/display/starfive/starfive,jh7110-inno-hdmi.yaml#
$schema: http://devicetree.org/meta-schemas/core.yaml#

title: Starfive JH7110 HDMI controller

description:
  The StarFive JH7110 SoC uses the HDMI signal transmiter based on innosilicon IP
  to generate HDMI signal from its input and transmit the signal to the screen.

maintainers:
  - Keith Zhao <keith.zhao@starfivetech.com>

properties:
  compatible:
    const: "starfive,jh7110-inno-hdmi"

  reg:
    minItems: 1

  interrupts:
    items:
      - description: The HDMI hot plug detection interrupt.

  clocks:
    items:
      - description: System clock of HDMI module.
      - description: Mclk clock of HDMI audio.
      - description: Bclk clock of HDMI audio.
      - description: Pixel clock generated by HDMI module.

  clock-names:
    items:
      - const: sysclk
      - const: mclk
      - const: bclk
      - const: pclk

  resets:
    items:
      - description: Reset for HDMI module.

  reset-names:
    items:
      - const: hdmi_tx

  '#sound-dai-cells':
    const: 0

  port:
    $ref: /schemas/graph.yaml#/properties/port
    description:
      Should contain a remote endpoint phandle of display controller device.

required:
  - compatible
  - reg
  - interrupts
  - clocks
  - clock-names
  - resets
  - reset-names
  - '#sound-dai-cells'
  - port

additionalProperties: false

examples:
  - |
    hdmi: hdmi@29590000 {
        compatible = "starfive,jh7110-inno-hdmi";
        reg = <0x29590000 0x4000>;
        interrupts = <99>;
        clocks = <&voutcrg 17>,
               <&voutcrg 15>,
               <&voutcrg 16>,
               <&hdmitx0_pixelclk>;
        clock-names = "sysclk", "mclk","bclk","pclk";
        resets = <&voutcrg 9>;
        reset-names = "hdmi_tx";
        #sound-dai-cells = <0>;
        hdmi_in: port {
            #address-cells = <1>;
            #size-cells = <0>;
            hdmi_in_dc: endpoint@0 {
                reg = <0>;
                remote-endpoint = <&dc_out_hdmi>;
            };
        };
    };
```
