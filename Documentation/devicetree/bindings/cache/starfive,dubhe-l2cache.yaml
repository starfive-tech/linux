## Documentation/devicetree/bindings/display/verisilicon/starfive-hdmi.yaml
```yaml
# SPDX-License-Identifier: GPL-2.0
%YAML 1.2
---
$id: http://devicetree.org/schemas/display/verisilicon/starfive-hdmi.yaml#
$schema: http://devicetree.org/meta-schemas/core.yaml#

title: StarFive SoC HDMI transmiter

description:
  The StarFive SoC uses the HDMI signal transmiter based on innosilicon IP 
  to generate HDMI signal from its input and transmit the signal to the screen.

maintainers:
  - Keith Zhao <keith.zhao@starfivetech.com>

properties:
  compatible:
    const: starfive,hdmi

  reg:
    minItems: 1

  interrupts:
    items:
      - description: The HDMI hot plug detection interrupt.

  clocks:
    items:
      - description: System clock of HDMI module.
      - description: Mclk clock of HDMI audio.
      - description: Bclk clock of HDMI audio.
      - description: Pixel clock generated by HDMI module.

  clock-names:
    items:
      - const: sysclk
      - const: mclk
      - const: bclk
      - const: pclk

  resets:
    items:
      - description: Reset for HDMI module.

  reset-names:
    items:
      - const: hdmi_tx

  '#sound-dai-cells':
    const: 0

  port:
    $ref: /schemas/graph.yaml#/properties/port
    description:
      Port node with one endpoint connected to a display connector node.

required:
  - compatible
  - reg
  - interrupts
  - clocks
  - clock-names
  - resets
  - reset-names
  - '#sound-dai-cells'
  - port

additionalProperties: false

examples:
  - |
    hdmi: hdmi@29590000 {
      compatible = "starfive,hdmi";
      reg = <0x29590000 0x4000>;
      interrupts = <99>;
      clocks = <&voutcrg 17>,
               <&voutcrg 15>,
               <&voutcrg 16>,
               <&hdmitx0_pixelclk>;
      clock-names = "sysclk", "mclk","bclk","pclk";
      resets = <&voutcrg 9>;
      reset-names = "hdmi_tx";
      #sound-dai-cells = <0>;
      hdmi_in: port {
          #address-cells = <1>;
          #size-cells = <0>;
          hdmi_input: endpoint@0 {
            reg = <0>;
            remote-endpoint = <&dc_out_dpi0>;
          };
      };
    };
```

## Documentation/devicetree/bindings/display/verisilicon/verisilicon-dc.yaml
```yaml
# SPDX-License-Identifier: GPL-2.0
%YAML 1.2
---
$id: http://devicetree.org/schemas/display/verisilicon/verisilicon-dc.yaml#
$schema: http://devicetree.org/meta-schemas/core.yaml#

title: StarFive SoC display controller

description:
  The StarFive SoC uses the display controller based on Verisilicon IP 
  to transfer the image data from a video memory
  buffer to an external LCD interface.

maintainers:
  - Keith Zhao <keith.zhao@starfivetech.com>

properties:
  compatible:
    const: verisilicon,dc8200

  reg:
    maxItems: 3

  interrupts:
    items:
      - description: The interrupt will be generated when DC finish one frame

  clocks:
    items:
      - description: Clock for display system noc bus.
      - description: Pixel clock for display channel 0.
      - description: Pixel clock for display channel 1.
      - description: Clock for axi interface of display controller.
      - description: Core clock for display controller.
      - description: Clock for ahb interface of display controller.
      - description: External HDMI pixel clock.
      - description: Parent clock for pixel clock

  clock-names:
    items:
      - const: clk_vout_noc_disp
      - const: clk_vout_pix0
      - const: clk_vout_pix1
      - const: clk_vout_axi
      - const: clk_vout_core
      - const: clk_vout_vout_ahb
      - const: hdmitx0_pixel
      - const: clk_vout_dc8200

  resets:
    items:
      - description: Reset for axi interface of display controller.
      - description: Reset for ahb interface of display controller.
      - description: Core reset of display controller.

  reset-names:
    items:
      - const: rst_vout_axi
      - const: rst_vout_ahb
      - const: rst_vout_core

  port:
    $ref: /schemas/graph.yaml#/properties/port
    description:
      Port node with one endpoint connected to a hdmi node.

required:
  - compatible
  - reg
  - interrupts
  - clocks
  - clock-names
  - resets
  - reset-names
  - port

additionalProperties: false

examples:
  - |
    dc8200: dc8200@29400000 {
      compatible = "verisilicon,dc8200";
      reg = <0x29400000 0x100>,
            <0x29400800 0x2000>,
            <0x295B0000 0x90>;
      interrupts = <95>;
      clocks = <&syscrg 60>,
               <&voutcrg 7>,
               <&voutcrg 8>,
               <&voutcrg 4>,
               <&voutcrg 5>,
               <&voutcrg 6>,
               <&hdmitx0_pixelclk>,
               <&voutcrg 1>;
      clock-names = "clk_vout_noc_disp", "clk_vout_pix0", "clk_vout_pix1", "clk_vout_axi",
                    "clk_vout_core", "clk_vout_vout_ahb", "hdmitx0_pixel","clk_vout_dc8200";
      resets = <&voutcrg 0>,
               <&voutcrg 1>,
               <&voutcrg 2>;
      reset-names = "rst_vout_axi","rst_vout_ahb","rst_vout_core";
      dc_out: port {
          #address-cells = <1>;
          #size-cells = <0>;
          dc_out_dpi0: endpoint@0 {
              reg = <0>;
              remote-endpoint = <&hdmi_input>;
          };
      };
    };
```

## Documentation/devicetree/bindings/display/verisilicon/verisilicon-drm.yaml
```yaml
# SPDX-License-Identifier: (GPL-2.0-only)
%YAML 1.2
---
$id: http://devicetree.org/schemas/display/verisilicon/verisilicon-drm.yaml#
$schema: http://devicetree.org/meta-schemas/core.yaml#

title: Verisilicon DRM master device

maintainers:
  - Keith Zhao <keith.zhao@starfivetech.com>

description: |
  The Verisilicon DRM master device is a virtual device needed to list all
  display controller or other display interface nodes that comprise the
  graphics subsystem.

properties:
  compatible:
    const: verisilicon,display-subsystem

  ports:
    $ref: /schemas/types.yaml#/definitions/phandle-array
    items:
      maxItems: 1
    description: |
      Should contain a list of phandles pointing to display interface ports
      of display controller devices. Display controller definitions as defined in
      Documentation/devicetree/bindings/display/verisilicon/verisilicon-dc.yaml

required:
  - compatible
  - ports

additionalProperties: false

examples:
  - |
    display-subsystem {
        compatible = "verisilicon,display-subsystem";
        ports = <&dc_out>;
    };
```

## Documentation/devicetree/bindings/gpio/starfive,jh7100-gpio.yaml
```yaml
# SPDX-License-Identifier: (GPL-2.0 OR BSD-2-Clause)
%YAML 1.2
---
$id: http://devicetree.org/schemas/gpio/starfive,jh7100-gpio.yaml#
$schema: http://devicetree.org/meta-schemas/core.yaml#

title: StarFive JH7100 GPIO controller

maintainers:
  - Huan Feng <huan.feng@starfivetech.com>
  - Drew Fustini <drew@beagleboard.org>

properties:
  compatible:
    items:
      - const: starfive,jh7100-gpio

  reg:
    maxItems: 1

  interrupts:
    description:
      Interrupt mapping, one per GPIO. Maximum 32 GPIOs.
    minItems: 1
    maxItems: 32

  gpio-controller: true

  "#gpio-cells":
    const: 2

  interrupt-controller: true

  "#interrupt-cells":
    const: 2

required:
  - compatible
  - reg
  - interrupts
  - interrupt-controller
  - "#interrupt-cells"
  - "#gpio-cells"
  - gpio-controller

additionalProperties: false

examples:
  - |
      gpio@11910000 {
        compatible = "starfive,jh7100-gpio";
        reg = <0x11910000 0x10000>;
        gpio-controller;
        #gpio-cells = <2>;
        interrupt-controller;
        #interrupt-cells = <2>;
        interrupts = <32>;
      };

...
```

## Documentation/devicetree/bindings/hwmon/starfive,jh7100-temp.yaml
```yaml
# SPDX-License-Identifier: (GPL-2.0-only OR BSD-2-Clause)
%YAML 1.2
---
$id: http://devicetree.org/schemas/hwmon/starfive,jh7100-temp.yaml#
$schema: http://devicetree.org/meta-schemas/core.yaml#

title: StarFive JH7100 Temperature Sensor

maintainers:
  - Emil Renner Berthing <kernel@esmil.dk>

description: |
  StarFive Technology Co. JH7100 embedded temperature sensor

properties:
  compatible:
    enum:
      - starfive,jh7100-temp

  reg:
    maxItems: 1

  '#thermal-sensor-cells':
    const: 0

  interrupts:
    maxItems: 1

required:
  - compatible
  - reg
  - interrupts

additionalProperties: false

examples:
  - |
    tmon: tmon@124a0000 {
        compatible = "starfive,jh7100-temp";
        reg = <0x124a0000 0x10000>;
        #thermal-sensor-cells = <0>;
        interrupts = <122>;
    };
```

## Documentation/devicetree/bindings/input/tinker_ft5406.yaml
```yaml
# SPDX-License-Identifier: GPL-2.0
%YAML 1.2
---
$id: http://devicetree.org/schemas/input/touchscreen/goodix.yaml#
$schema: http://devicetree.org/meta-schemas/core.yaml#

title: Tinker FT5406 touchscreen controller Bindings

maintainers:
  - Changhuang Liang <changhuang.liang@starfivetech.com>

allOf:
  - $ref: touchscreen.yaml#

properties:
  compatible:
    const: tinker_ft5406

  reg:
    const: 0x38

additionalProperties: false

required:
  - compatible
  - reg

examples:
  - |
    i2c {
      #address-cells = <1>;
      #size-cells = <0>;
      tinker_ft5406@38 {
        compatible = "tinker_ft5406";
        reg = <0x38>;
      };
    };

...
```

## Documentation/devicetree/bindings/media/cdns,csi2rx.yaml
```yaml
# SPDX-License-Identifier: (GPL-2.0 OR BSD-2-Clause)
%YAML 1.2
---
$id: http://devicetree.org/schemas/media/cdns,csi2rx.yaml#
$schema: http://devicetree.org/meta-schemas/core.yaml#

title: Cadence MIPI-CSI2 RX controller

maintainers:
  - Maxime Ripard <mripard@kernel.org>

description:
  The Cadence MIPI-CSI2 RX controller is a CSI-2 bridge supporting up to 4 CSI
  lanes in input, and 4 different pixel streams in output.

properties:
  compatible:
    enum:
      - cdns,csi2rx

  reg:
    maxItems: 1

  clocks:
    items:
      - description: CSI2Rx system clock
      - description: Gated Register bank clock for APB interface
      - description: pixel Clock for Stream interface 0
      - description: pixel Clock for Stream interface 1
      - description: pixel Clock for Stream interface 2
      - description: pixel Clock for Stream interface 3

  clock-names:
    items:
      - const: sys
      - const: reg_bank
      - const: pixel_if0
      - const: pixel_if1
      - const: pixel_if2
      - const: pixel_if3

  resets:
    items:
      - description: CSI2Rx system reset
      - description: Gated Register bank reset for APB interface
      - description: pixel reset for Stream interface 0
      - description: pixel reset for Stream interface 1
      - description: pixel reset for Stream interface 2
      - description: pixel reset for Stream interface 3

  reset-names:
    items:
      - const: sys
      - const: reg_bank
      - const: pixel_if0
      - const: pixel_if1
      - const: pixel_if2
      - const: pixel_if3

  phys:
    maxItems: 1
    description: MIPI D-PHY

  phy-names:
    items:
      - const: dphy

  ports:
    $ref: /schemas/graph.yaml#/properties/ports

    properties:
      port@0:
        $ref: /schemas/graph.yaml#/$defs/port-base
        unevaluatedProperties: false
        description:
          Input port node, single endpoint describing the CSI-2 transmitter.

        properties:
          endpoint:
            $ref: video-interfaces.yaml#
            unevaluatedProperties: false

            properties:
              bus-type:
                enum:
                  - 4

              clock-lanes:
                maximum: 4

              data-lanes:
                minItems: 1
                maxItems: 4
                items:
                  maximum: 4

            required:
              - clock-lanes
              - data-lanes

      port@1:
        $ref: /schemas/graph.yaml#/properties/port
        description:
          Output port node

    required:
      - port@0
      - port@1

required:
  - compatible
  - reg
  - clocks
  - clock-names
  - ports

additionalProperties: false

examples:
  - |
    csi2rx: csi@0d060000 {
        compatible = "cdns,csi2rx";
        reg = <0x0d060000 0x1000>;
        clocks = <&byteclock 7>, <&byteclock 6>,
                 <&coreclock 8>, <&coreclock 9>,
                 <&coreclock 10>, <&coreclock 11>;
        clock-names = "sys", "reg_bank",
                      "pixel_if0", "pixel_if1",
                      "pixel_if2", "pixel_if3";
        resets = <&bytereset 9>, <&bytereset 4>,
                 <&corereset 5>, <&corereset 6>,
                 <&corereset 7>, <&corereset 8>;
        reset-names = "sys", "reg_bank",
                      "pixel_if0", "pixel_if1",
                      "pixel_if2", "pixel_if3";
        phys = <&csi_phy>;
        phy-names = "dphy";

        ports {
                #address-cells = <1>;
                #size-cells = <0>;

                port@0 {
                    reg = <0>;

                    csi2rx_in_sensor: endpoint {
                        remote-endpoint = <&sensor_out_csi2rx>;
                        clock-lanes = <0>;
                        data-lanes = <1 2>;
                    };
                };

                port@1 {
                    reg = <1>;

                    csi2rx_out_grabber0: endpoint {
                        remote-endpoint = <&grabber0_in_csi2rx>;
                    };
                };
        };
    };

...
```
